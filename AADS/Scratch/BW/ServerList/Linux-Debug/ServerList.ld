SEARCH_DIR(C:\Projects\AADS\xCore/3rdparty/linux/lib)
GROUP(
      \Projects\AADS\xCore\Entropy\Linux-Debug\Entropy.lib
      \Projects\AADS\xCore\x_files\Linux-Debug\x_files.lib
      \Projects\AADS\Support\netlib\Linux-Debug\NetLib.lib
      C:\Projects\AADS\xCore/3rdparty/linux/lib/crti.o
      C:\Projects\AADS\xCore/3rdparty/linux/lib/crtbegin.o
      C:\Projects\AADS\xCore/3rdparty/linux/lib/crtend.o
      C:\Projects\AADS\xCore/3rdparty/linux/lib/crtn.o
      C:\Projects\AADS\xCore/3rdparty/linux/lib/crt1.o
      C:\Projects\AADS\xCore/3rdparty/linux/lib/libm.a
      C:\Projects\AADS\xCore/3rdparty/linux/lib/libstdc++.a
      C:\Projects\AADS\xCore/3rdparty/linux/lib/libgcc.a
      C:\Projects\AADS\xCore/3rdparty/linux/lib/libc.a
      C:\Projects\AADS\xCore/3rdparty/linux/lib/libpthread.a
      .\Linux-debug\main.obj
)
INCLUDE linux.ld